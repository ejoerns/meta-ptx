## .github/meta-ptx-tests/conf/layer.conf
```bitbake
# We have a conf and classes directory, add to BBPATH
BBPATH .= ":${LAYERDIR}"

# We have recipes-* directories, add to BBFILES
BBFILES += "${LAYERDIR}/recipes-*/*/*.bb \
            ${LAYERDIR}/recipes-*/*/*.bbappend"

BBFILE_COLLECTIONS += "meta-ptx-tests"
BBFILE_PATTERN_meta-ptx-tests = "^${LAYERDIR}/"
BBFILE_PRIORITY_meta-ptx-tests = "6"

LAYERDEPENDS_meta-ptx-tests = "core"
LAYERSERIES_COMPAT_meta-ptx-tests = "dunfell gatesgarth hardknott honister"
```
